## kernel/arch/arm/configs/fp1_defconfig
```kconfig
# CONFIG_ARM_PATCH_PHYS_VIRT is not set
CONFIG_EXPERIMENTAL=y
# CONFIG_LOCALVERSION_AUTO is not set
CONFIG_IKCONFIG=y
CONFIG_IKCONFIG_PROC=y
CONFIG_CGROUPS=y
CONFIG_CGROUP_CPUACCT=y
CONFIG_CGROUP_SCHED=y
CONFIG_RT_GROUP_SCHED=y
CONFIG_BLK_DEV_INITRD=y
CONFIG_PANIC_TIMEOUT=5
CONFIG_SYSCTL_SYSCALL=y
CONFIG_EMBEDDED=y
CONFIG_PROFILING=y
CONFIG_OPROFILE=y
CONFIG_KPROBES=y
CONFIG_MODULES=y
CONFIG_MODULE_UNLOAD=y
# CONFIG_BLK_DEV_BSG is not set
CONFIG_ARM_THUMBEE=y
CONFIG_FIQ_DEBUGGER=y
CONFIG_FIQ_DEBUGGER_CONSOLE=y
CONFIG_FIQ_DEBUGGER_CONSOLE_DEFAULT_ENABLE=y
CONFIG_NO_HZ=y
CONFIG_HIGH_RES_TIMERS=y
CONFIG_SMP=y
CONFIG_PREEMPT=y
CONFIG_AEABI=y
# CONFIG_OABI_COMPAT is not set
CONFIG_HIGHMEM=y
CONFIG_CC_STACKPROTECTOR=y
CONFIG_CMDLINE="console=tty0 console=ttyMT3,921600n1 root=/dev/ram vmalloc=530M slub_max_order=0 slub_debug=O "
CONFIG_CPU_FREQ=y
CONFIG_CPU_FREQ_STAT_DETAILS=y
CONFIG_CPU_FREQ_DEFAULT_GOV_HOTPLUG=y
CONFIG_CPU_FREQ_GOV_POWERSAVE=y
CONFIG_CPU_FREQ_GOV_USERSPACE=y
CONFIG_CPU_FREQ_GOV_ONDEMAND=y
CONFIG_VFP=y
CONFIG_NEON=y
# CONFIG_CORE_DUMP_DEFAULT_ELF_HEADERS is not set
CONFIG_HIBERNATION=y
CONFIG_TOI_DEFAULT_WAIT=2
CONFIG_PM_AUTOSLEEP=y
CONFIG_PM_WAKELOCKS=y
CONFIG_PM_DEBUG=y
CONFIG_PM_ADVANCED_DEBUG=y
CONFIG_PM_TEST_SUSPEND=y
CONFIG_NET=y
CONFIG_PACKET=y
CONFIG_UNIX=y
CONFIG_XFRM_MIGRATE=y
CONFIG_NET_KEY=y
CONFIG_INET=y
CONFIG_IP_MULTICAST=y
CONFIG_IP_ADVANCED_ROUTER=y
CONFIG_IP_MULTIPLE_TABLES=y
CONFIG_IP_PNP=y
CONFIG_IP_PNP_DHCP=y
CONFIG_IP_PNP_BOOTP=y
CONFIG_NET_IPIP=y
CONFIG_IP_MROUTE=y
CONFIG_IP_MROUTE_MULTIPLE_TABLES=y
CONFIG_IP_PIMSM_V1=y
CONFIG_IP_PIMSM_V2=y
CONFIG_ARPD=y
CONFIG_SYN_COOKIES=y
CONFIG_INET_AH=y
CONFIG_INET_ESP=y
CONFIG_INET_IPCOMP=y
# CONFIG_INET_LRO is not set
CONFIG_IPV6=y
CONFIG_IPV6_PRIVACY=y
CONFIG_IPV6_ROUTER_PREF=y
CONFIG_IPV6_ROUTE_INFO=y
CONFIG_IPV6_OPTIMISTIC_DAD=y
CONFIG_INET6_AH=y
CONFIG_INET6_ESP=y
CONFIG_INET6_IPCOMP=y
CONFIG_IPV6_MIP6=y
CONFIG_INET6_XFRM_MODE_ROUTEOPTIMIZATION=y
CONFIG_IPV6_SIT_6RD=y
CONFIG_IPV6_TUNNEL=y
CONFIG_IPV6_MULTIPLE_TABLES=y
CONFIG_IPV6_SUBTREES=y
CONFIG_IPV6_MROUTE=y
CONFIG_IPV6_PIMSM_V2=y
CONFIG_NETFILTER=y
CONFIG_NF_CONNTRACK=y
CONFIG_NF_CONNTRACK_EVENTS=y
CONFIG_NF_CT_PROTO_UDPLITE=y
CONFIG_NF_CONNTRACK_FTP=y
CONFIG_NF_CONNTRACK_PPTP=y
CONFIG_NF_CONNTRACK_SIP=y
CONFIG_NF_CONNTRACK_TFTP=y
CONFIG_NF_CT_NETLINK=y
CONFIG_NETFILTER_TPROXY=y
CONFIG_NETFILTER_XT_CONNMARK=y
CONFIG_NETFILTER_XT_TARGET_CLASSIFY=y
CONFIG_NETFILTER_XT_TARGET_IDLETIMER=y
CONFIG_NETFILTER_XT_TARGET_MARK=y
CONFIG_NETFILTER_XT_TARGET_NFLOG=y
CONFIG_NETFILTER_XT_TARGET_NFQUEUE=y
CONFIG_NETFILTER_XT_MATCH_CONNBYTES=y
CONFIG_NETFILTER_XT_MATCH_IPRANGE=y
CONFIG_NETFILTER_XT_MATCH_LENGTH=y
CONFIG_NETFILTER_XT_MATCH_LIMIT=y
CONFIG_NETFILTER_XT_MATCH_MAC=y
CONFIG_NETFILTER_XT_MATCH_MARK=y
CONFIG_NETFILTER_XT_MATCH_MULTIPORT=y
CONFIG_NETFILTER_XT_MATCH_POLICY=y
CONFIG_NETFILTER_XT_MATCH_PHYSDEV=y
CONFIG_NETFILTER_XT_MATCH_QTAGUID=y
CONFIG_NETFILTER_XT_MATCH_QUOTA=y
CONFIG_NETFILTER_XT_MATCH_QUOTA2=y
CONFIG_NETFILTER_XT_MATCH_QUOTA2_LOG=y
CONFIG_NETFILTER_XT_MATCH_REALM=y
CONFIG_NETFILTER_XT_MATCH_RECENT=y
CONFIG_NETFILTER_XT_MATCH_SOCKET=y
CONFIG_NETFILTER_XT_MATCH_STATE=y
CONFIG_NETFILTER_XT_MATCH_STATISTIC=y
CONFIG_NETFILTER_XT_MATCH_STRING=y
CONFIG_NETFILTER_XT_MATCH_TIME=y
CONFIG_NETFILTER_XT_MATCH_U32=y
CONFIG_NF_CONNTRACK_IPV4=y
CONFIG_IP_NF_IPTABLES=y
CONFIG_IP_NF_FILTER=y
CONFIG_IP_NF_TARGET_REJECT=y
CONFIG_NF_NAT=y
CONFIG_IP_NF_TARGET_MASQUERADE=y
CONFIG_IP_NF_TARGET_NETMAP=y
CONFIG_IP_NF_TARGET_REDIRECT=y
CONFIG_IP_NF_MANGLE=y
CONFIG_IP_NF_RAW=y
CONFIG_IP_NF_ARPTABLES=y
CONFIG_NF_CONNTRACK_IPV6=y
CONFIG_IP6_NF_QUEUE=y
CONFIG_IP6_NF_IPTABLES=y
CONFIG_IP6_NF_MATCH_FRAG=y
CONFIG_IP6_NF_MATCH_IPV6HEADER=y
CONFIG_IP6_NF_TARGET_HL=y
CONFIG_IP6_NF_FILTER=y
CONFIG_IP6_NF_TARGET_REJECT=y
CONFIG_IP6_NF_TARGET_REJECT_SKERR=y
CONFIG_IP6_NF_MANGLE=y
CONFIG_IP6_NF_RAW=y
CONFIG_BRIDGE=y
CONFIG_VLAN_8021Q=y
CONFIG_NET_SCHED=y
CONFIG_NET_SCH_HTB=y
CONFIG_NET_SCH_INGRESS=y
CONFIG_NET_CLS_FW=y
CONFIG_NET_CLS_U32=y
CONFIG_CLS_U32_PERF=y
CONFIG_CLS_U32_MARK=y
CONFIG_NET_CLS_FLOW=y
CONFIG_NET_CLS_ACT=y
CONFIG_NET_ACT_POLICE=y
CONFIG_NET_ACT_MIRRED=y
CONFIG_NET_ACT_IPT=y
CONFIG_NET_CLS_IND=y
CONFIG_CFG80211=y
CONFIG_NL80211_TESTMODE=y
CONFIG_CFG80211_DEVELOPER_WARNINGS=y
# CONFIG_CFG80211_DEFAULT_PS is not set
CONFIG_CFG80211_DEBUGFS=y
CONFIG_CFG80211_INTERNAL_REGDB=y
CONFIG_WIRELESS_EXT_SYSFS=y
CONFIG_LIB80211=y
CONFIG_LIB80211_DEBUG=y
CONFIG_SYNC=y
CONFIG_SW_SYNC=y
CONFIG_SW_SYNC_USER=y
CONFIG_MTD=y
CONFIG_MTD_CHAR=y
CONFIG_MTD_BLOCK=y
CONFIG_MTD_NAND=y
CONFIG_MTD_NAND_PLATFORM=y
CONFIG_BLK_DEV_LOOP=y
CONFIG_UID_STAT=y
CONFIG_SCSI=y
CONFIG_SCSI_TGT=m
CONFIG_BLK_DEV_SD=y
CONFIG_SCSI_MULTI_LUN=y
CONFIG_SCSI_SCAN_ASYNC=y
# CONFIG_SCSI_LOWLEVEL is not set
CONFIG_MD=y
CONFIG_BLK_DEV_DM=y
CONFIG_DM_DEBUG=y
CONFIG_DM_CRYPT=y
CONFIG_DM_UEVENT=y
CONFIG_NETDEVICES=y
CONFIG_IFB=y
CONFIG_TUN=y
# CONFIG_ETHERNET is not set
CONFIG_PPP=y
CONFIG_PPP_BSDCOMP=y
CONFIG_PPP_DEFLATE=y
CONFIG_PPP_FILTER=y
CONFIG_PPP_MPPE=y
CONFIG_PPP_MULTILINK=y
CONFIG_PPPOE=y
CONFIG_PPPOLAC=y
CONFIG_PPPOPNS=y
CONFIG_PPP_ASYNC=y
CONFIG_PPP_SYNC_TTY=y
CONFIG_INPUT_EVDEV=y
# CONFIG_KEYBOARD_ATKBD is not set
# CONFIG_MOUSE_PS2 is not set
CONFIG_INPUT_TOUCHSCREEN=y
CONFIG_INPUT_MISC=y
CONFIG_INPUT_UINPUT=y
# CONFIG_SERIO_SERPORT is not set
CONFIG_SERIO_AMBAKMI=y
CONFIG_SERIO_LIBPS2=y
# CONFIG_VT is not set
CONFIG_LEGACY_PTY_COUNT=16
# CONFIG_HW_RANDOM is not set
CONFIG_I2C=y
CONFIG_SPI=y
CONFIG_POWER_SUPPLY=y
# CONFIG_HWMON is not set
CONFIG_THERMAL=y
CONFIG_ION=y
CONFIG_FB=y
CONFIG_FB_MODE_HELPERS=y
CONFIG_FB_TILEBLITTING=y
CONFIG_LOGO=y
CONFIG_SOUND=y
CONFIG_SND=y
CONFIG_SND_PCM_OSS=y
# CONFIG_SND_PCM_OSS_PLUGINS is not set
# CONFIG_SND_SUPPORT_OLD_API is not set
# CONFIG_SND_ARM is not set
# CONFIG_SND_SPI is not set
# CONFIG_SND_USB is not set
CONFIG_HID_A4TECH=y
CONFIG_HID_APPLE=y
CONFIG_HID_BELKIN=y
CONFIG_HID_CHERRY=y
CONFIG_HID_CHICONY=y
CONFIG_HID_CYPRESS=y
CONFIG_HID_DRAGONRISE=y
CONFIG_HID_EZKEY=y
CONFIG_HID_KYE=y
CONFIG_HID_GYRATION=y
CONFIG_HID_TWINHAN=y
CONFIG_HID_KENSINGTON=y
CONFIG_HID_LOGITECH=y
CONFIG_HID_MICROSOFT=y
CONFIG_HID_MONTEREY=y
CONFIG_HID_NTRIG=y
CONFIG_HID_PANTHERLORD=y
CONFIG_HID_PETALYNX=y
CONFIG_HID_SAMSUNG=y
CONFIG_HID_SONY=y
CONFIG_HID_SUNPLUS=y
CONFIG_HID_GREENASIA=y
CONFIG_HID_SMARTJOYPLUS=y
CONFIG_HID_TOPSEED=y
CONFIG_HID_THRUSTMASTER=y
CONFIG_HID_ZEROPLUS=y
CONFIG_USB=y
CONFIG_USB_DEBUG=y
CONFIG_USB_DEVICEFS=y
CONFIG_USB_ACM=y
CONFIG_USB_STORAGE=y
CONFIG_USB_STORAGE_DEBUG=y
CONFIG_USB_STORAGE_DATAFAB=y
CONFIG_USB_STORAGE_FREECOM=y
CONFIG_USB_STORAGE_ISD200=y
CONFIG_USB_STORAGE_USBAT=y
CONFIG_USB_STORAGE_SDDR09=y
CONFIG_USB_STORAGE_SDDR55=y
CONFIG_USB_STORAGE_JUMPSHOT=y
CONFIG_USB_STORAGE_ALAUDA=y
CONFIG_USB_STORAGE_ONETOUCH=y
CONFIG_USB_STORAGE_KARMA=y
CONFIG_USB_STORAGE_CYPRESS_ATACB=y
CONFIG_USB_LIBUSUAL=y
CONFIG_USB_TRANCEVIBRATOR=y
CONFIG_USB_GADGET=y
CONFIG_USB_GADGET_VBUS_DRAW=500
CONFIG_USB_G_ANDROID=y
CONFIG_MMC=y
CONFIG_MMC_UNSAFE_RESUME=y
CONFIG_MMC_BLOCK_MINORS=32
CONFIG_NEW_LEDS=y
CONFIG_LEDS_CLASS=y
CONFIG_LEDS_TRIGGERS=y
CONFIG_LEDS_TRIGGER_TIMER=y
CONFIG_SWITCH=y
CONFIG_RTC_CLASS=y
CONFIG_STAGING=y
CONFIG_ANDROID=y
CONFIG_ANDROID_BINDER_IPC=y
CONFIG_ASHMEM=y
CONFIG_ANDROID_LOGGER=y
CONFIG_ANDROID_LOW_MEMORY_KILLER=y
CONFIG_ANDROID_INTF_ALARM_DEV=y
CONFIG_EXT3_FS=y
# CONFIG_EXT3_DEFAULTS_TO_ORDERED is not set
CONFIG_EXT3_FS_POSIX_ACL=y
CONFIG_EXT4_FS=y
CONFIG_EXT4_DEBUG=y
CONFIG_JBD_DEBUG=y
CONFIG_QUOTA=y
CONFIG_QFMT_V2=y
CONFIG_FUSE_FS=y
CONFIG_ISO9660_FS=y
CONFIG_JOLIET=y
CONFIG_ZISOFS=y
CONFIG_MSDOS_FS=y
CONFIG_VFAT_FS=y
CONFIG_TMPFS=y
CONFIG_YAFFS_FS=y
CONFIG_YAFFS_DISABLE_TAGS_ECC=y
CONFIG_NLS_CODEPAGE_437=y
CONFIG_NLS_CODEPAGE_950=y
CONFIG_NLS_ASCII=y
CONFIG_NLS_ISO8859_1=y
CONFIG_NLS_UTF8=y
CONFIG_PRINTK_TIME=y
CONFIG_FRAME_WARN=2048
CONFIG_SCHEDSTATS=y
CONFIG_SLUB_DEBUG_ON=y
CONFIG_PROVE_LOCKING=y
CONFIG_DEBUG_LOCKDEP=y
# CONFIG_DEBUG_BUGVERBOSE is not set
CONFIG_DEBUG_INFO=y
CONFIG_FAULT_INJECTION=y
# CONFIG_KPROBE_EVENT is not set
CONFIG_KGDB=y
CONFIG_KGDB_KDB=y
# CONFIG_ARM_UNWIND is not set
CONFIG_CRYPTO_SHA256=y
CONFIG_CRYPTO_AES=y
CONFIG_CRYPTO_TWOFISH=y
CONFIG_CRYPTO_LZO=y
CONFIG_CRYPTO_LZF=y
# CONFIG_CRYPTO_ANSI_CPRNG is not set
# CONFIG_CRYPTO_HW is not set
CONFIG_LIBCRC32C=y
CONFIG_MEDIATEK_SOLUTION=y
CONFIG_ARCH_MT6589=y
CONFIG_MTK_SCHED_TRACERS=y
CONFIG_MT65XX_TRACER=y
CONFIG_MTPROF_CPUTIME=y
CONFIG_MTPROF_IRQ_DURATION=y
CONFIG_MTK_AEE_FEATURE=y
# CONFIG_ANDROID_VMEM is not set
CONFIG_MTK_RAM_CONSOLE=y
CONFIG_MTK_RAM_CONSOLE_SIZE=0x1C00
CONFIG_MTK_RAM_CONSOLE_ADDR=0xF900DC00
CONFIG_PREEMPT_MONITOR=y
CONFIG_ISR_MONITOR=y
CONFIG_MT_SCHED_MONITOR=y
CONFIG_MT_CHRDEV_REG=y
CONFIG_MT_DEBUG_MUTEXES=y
CONFIG_PRINTK_PROCESS_INFO=y
CONFIG_MT_ENG_BUILD=y
CONFIG_MTK_MEMCFG=y
CONFIG_MT_SCHED=y
CONFIG_MT_LOAD_BALANCE_ENHANCEMENT=y
CONFIG_MT_LOAD_BALANCE_PROFILER=y
CONFIG_MT_SCHED_DEBUG_ONLY=y
CONFIG_MTK_CIRQ=y
CONFIG_MT6589_EVB_BOARD=y
CONFIG_MAX_DRAM_SIZE_SUPPORT=0x80000000
CONFIG_MTK_ACCDET=y
CONFIG_MTK_BT_NET_DEV=y
CONFIG_MTK_CCCI_DEVICES=y
CONFIG_MTK_NET_CCMNI=y
CONFIG_MTK_FB=y
CONFIG_MTK_COMBO=m
CONFIG_MTK_COMBO_BT=m
CONFIG_MTK_COMBO_GPS=m
CONFIG_MTK_COMBO_WIFI=m
CONFIG_MTK_FM=m
CONFIG_MTK_VIDEOCODEC_DRIVER=m
CONFIG_MTK_KEYPAD=y
CONFIG_KEYBOARD_HID=y
CONFIG_MTK_LEDS=y
CONFIG_MTK_MMC=y
# CONFIG_POWER_EXT is not set
CONFIG_MTK_SOUND=y
CONFIG_MTK_TOUCHPANEL=y
CONFIG_USB_MTK_HDRC_GADGET=y
CONFIG_USB_MTK_OTG=y
CONFIG_USB_MTK_DEBUG_FS=y
CONFIG_USB_MTK_DEBUG=y
CONFIG_USB_MTK_HDRC_HCD=y
CONFIG_ION_MTK=y
CONFIG_MMPROFILE=y
CONFIG_ARCH_MTK_PROJECT="ahong89_wet_jb2"
CONFIG_CUSTOM_KERNEL_ACCELEROMETER=y
CONFIG_CUSTOM_KERNEL_ALSPS=y
CONFIG_CUSTOM_KERNEL_FLASHLIGHT="constant_flashlight"
CONFIG_CUSTOM_KERNEL_GYROSCOPE=y
CONFIG_CUSTOM_KERNEL_IMGSENSOR="imx179_mipi_raw mt9m114_yuv"
CONFIG_CUSTOM_KERNEL_LCM="nt35516_qhd_dsi_cmd"
CONFIG_CUSTOM_KERNEL_MAGNETOMETER=y
CONFIG_CUSTOM_KERNEL_SSW=y
CONFIG_CUSTOM_KERNEL_TOUCHPANEL="ft5316"
CONFIG_CUSTOM_KERNEL_LENS="fm50af dummy_lens"
CONFIG_MTK_BMA250=y
CONFIG_MTK_STK3171=y
CONFIG_MTK_MPU3050C=y
CONFIG_MTK_MMC3416=y
CONFIG_MTK_AMP_YAD=y
CONFIG_MTK_SSW_GENERIC=y
```

## mediatek/custom/Kconfig
```kconfig
menu "MediaTek Custom Configurations"

config ARCH_MTK_PROJECT
	string "MediaTek project name"

# General "CUSTOM_KERNEL_*" options are copied from the
# "drivers/misc/mediatek/Kconfig" of the official MediaTek kernel for Android:
# https://android.googlesource.com/kernel/mediatek/+/android-4.4.4_r3/drivers/misc/mediatek/Kconfig

config CUSTOM_KERNEL_ACCELEROMETER
	bool "CUSTOM_KERNEL_ACCELEROMETER"
	help
	   accelerometer sensor to detect accelerometer from x y z axis.

config CUSTOM_KERNEL_ALSPS
	bool "CUSTOM_KERNEL_ALSPS"
	help
	   ALSPS sensor driverto detect ambint light and the object is close
	   or far awary from device

config CUSTOM_KERNEL_FLASHLIGHT
	string "CUSTOM_KERNEL_FLASHLIGHT"
	help
	   Kernel space cameara flashlight driver. You can use this driver
	   choose cameara flashlight type.

config CUSTOM_KERNEL_GYROSCOPE
	bool "CUSTOM_KERNEL_GYROSCOPE"
	help
	   gyro driver

config CUSTOM_KERNEL_IMGSENSOR
	string "CUSTOM_KERNEL_IMGSENSOR"
	help
	   Kernel space image sensor driver. Define  project used all image
	   sensors .The value is combination of CUSTOM_KERNEL_MAIN_IMGSENSOR,
	   CUSTOM_KERNEL_MAIN_BACKUP_IMGSENSOR, CUSTOM_KERNEL_SUB_IMGSENSOR,
	   and CUSTOM_KERNEL_SUB_BACKUP_IMGSENSOR

config CUSTOM_KERNEL_LCM
	string "CUSTOM_KERNEL_LCM"
	help
	   To choose kernel LCM driver name

config CUSTOM_KERNEL_MAGNETOMETER
	bool "CUSTOM_KERNEL_MAGNETOMETER"
	help
	   compass driver to detect compass raw data and report orientatino
	   data

config CUSTOM_KERNEL_SSW
	bool "CUSTOM_KERNEL_SSW"

config CUSTOM_KERNEL_TOUCHPANEL
	string "CUSTOM_KERNEL_TOUCHPANEL"
	help
	   touch driver need to report correct touch axes



# Special CUSTOM_KERNEL_ options

config CUSTOM_KERNEL_CAM_CAL
	string "CUSTOM_KERNEL_CAM_CAL"
	default "dummy_eeprom"

config CUSTOM_KERNEL_EEPROM
	string "CUSTOM_KERNEL_EEPROM"
	default "dummy_eeprom"

config CUSTOM_KERNEL_LENS
	string "CUSTOM_KERNEL_LENS"
	default "dummy_lens"



# Accelerometer sensor
config MTK_BMA250
        bool "BMA250 accelerometer for MediaTek package"
        default n

# ALSPS sensor
config MTK_STK3171
        bool "STK3171 ALSPS for MediaTek package"
        default n

# Gyroscope sensor
config MTK_MPU3050C
        bool "MPU3050C gyroscope for MediaTek package"
        default n

# Magnetometer sensor
config MTK_MMC3416
        bool "MMC3416 magnetometer for MediaTek package"
        default n



# MTK sound driver
config MTK_AMP_YAD
        bool "AMP_YAD MTK sound driver for MediaTek package"
        default n

# SSW driver
config MTK_SSW_GENERIC
        bool "SSW_GENERIC SSW driver for MediaTek package"
        default n

endmenu
```
